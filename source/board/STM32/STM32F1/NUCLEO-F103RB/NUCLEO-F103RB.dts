/**
 * \file
 * \brief Devicetree for NUCLEO-F103RB
 *
 * \author Copyright (C) 2017 Kamil Szczygiel http://www.distortec.com http://www.freddiechopin.info
 *
 * \par License
 * This Source Code Form is subject to the terms of the Mozilla Public License, v. 2.0. If a copy of the MPL was not
 * distributed with this file, You can obtain one at http://mozilla.org/MPL/2.0/.
 */

/dts-v1/;

#include "STM32F103RB.dtsi"

/ {
	compatible = "ST,NUCLEO-F103RB", "ST,STM32F103RB";
	model = "STMicroelectronics NUCLEO-F103RB";
};

&gpioa {
	status = "okay";
};

&gpioc {
	status = "okay";
};
