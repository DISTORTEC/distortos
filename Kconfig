## Kconfig
```kconfig
#
# file: Kconfig
#
# author: Copyright (C) 2015-2017 Kamil Szczygiel http://www.distortec.com http://www.freddiechopin.info
#
# This Source Code Form is subject to the terms of the Mozilla Public License, v. 2.0. If a copy of the MPL was not
# distributed with this file, You can obtain one at http://mozilla.org/MPL/2.0/.
#

config DISTORTOS_PATH
	string
	option env="DISTORTOS_PATH"
	default "."

config OUTPUT
	string
	option env="OUTPUT"
	default "./output"

source "$DISTORTOS_PATH/source/chip/Kconfig"
source "$DISTORTOS_PATH/source/scheduler/Kconfig"

menu "Applications configuration"

source "$OUTPUT/Kconfig-applicationOptions"

endmenu

menu "Build configuration"

config TOOLCHAIN_PREFIX
	string "Cross toolchain prefix"
	default ""
	help
		Cross toolchain prefix used during compilation.

choice
	prompt "Optimization level"
	default BUILD_OPTIMIZATION_O2
	help
		Selects optimization level.

config BUILD_OPTIMIZATION_O0
	bool "No optimization (-O0)"
	help
		Disable all optimizations.

config BUILD_OPTIMIZATION_O1
	bool "Optimize (-O1)"
	help
		Optimize.

config BUILD_OPTIMIZATION_O2
	bool "Optimize even more (-O2)"
	help
		Optimize even more.

config BUILD_OPTIMIZATION_O3
	bool "Optimize yet more (-O3)"
	help
		Optimize yet more.

config BUILD_OPTIMIZATION_OS
	bool "Optimize for size (-Os)"
	help
		Optimize for size.

config BUILD_OPTIMIZATION_OG
	bool "Optimize debugging experience (-Og)"
	help
		Optimize debugging experience.

endchoice

config LINK_TIME_OPTIMIZATION_ENABLE
	bool "Enable link-time optimization (EXPERIMENTAL)"
	default n
	help
		Enable link-time optimization of the whole application.

		Note that enabling this feature causes misleading "one definition rule
		violation" warnings in toolchains based on GCC 5, probably related to
		GCC's bug 66180.

config STATIC_DESTRUCTORS_ENABLE
	bool "Enable static destructors"
	default n
	help
		Enable destructors for objects with static storage duration. As
		embedded applications almost never "exit", these destructors are
		usually never executed, wasting ROM.

config STATIC_DESTRUCTORS_RUN_TIME_REGISTRATION_ENABLE
	bool "Register static destructors in run time"
	default n
	depends on STATIC_DESTRUCTORS_ENABLE
	help
		Register destructors for objects with static storage duration in run
		time (with __cxa_atexit()). Such behaviour is required for fully
		standards-compliant handling of static destructors, especially when
		C++ exceptions are used, but it uses more ROM and RAM (possibly
		allocated from the heap).

		If this option is disabled, all of these destructors are placed in an
		array and executed at program exit in appropriate order (reversed in
		respect to constructors).

config DEBUGGING_INFORMATION_ENABLE
	bool "Enable generation of debugging information"
	default y
	help
		Enables generation of debugging information.

config ASSERT_ENABLE
	bool "Enable asserts"
	default n
	help
		Enables asserts.

config LDSCRIPT_ROM_SIZE_MANUAL_CONFIGURATION
	bool "Configure ROM's address & size in linker script"
	default n
	depends on !BOARD_HAS_YAML
	help
		Enables manual configuration of ROM's offset and size in generated
		linker script. Example uses of this option are:
		- the device has a bootloader at the beginning of flash, so the
		application must not use the memory reserved for bootloader;
		- the application is a bootloader, so rest of flash must be left for
		loaded application;
		- the application uses a few last ROM pages for its own purposes (e.g.
		emulated EEPROM, storing configuration, logging, ...);
		- ...

		Note - configured offsets should take ROM page sizes into account.

		Examples (CHIP_ROM_SIZE == 10):

		1. whole ROM (10 bytes) used for application - begin == 0, end == 10

		begin                end
		  |                   |
		  v                   v
		 ╔═╦═╦═╦═╦═╦═╦═╦═╦═╦═╗
		 ║0║1║2║3║4║5║6║7║8║9║
		 ╚═╩═╩═╩═╩═╩═╩═╩═╩═╩═╝

		2. beginning of ROM (3 bytes) left unused, rest (7 bytes) used by
		application - begin == 3, end == 10

		      begin          end
		        |             |
		        v             v
		 ┌─┬─┬─╦═╦═╦═╦═╦═╦═╦═╗
		 │0│1│2║3║4║5║6║7║8║9║
		 └─┴─┴─╩═╩═╩═╩═╩═╩═╩═╝

		3. end of ROM (2 bytes) left unused, rest (8 bytes) used by
		application - begin == 0, end == 8

		begin            end
		  |               |
		  v               v
		 ╔═╦═╦═╦═╦═╦═╦═╦═╦─┬─┐
		 ║0║1║2║3║4║5║6║7║8│9│
		 ╚═╩═╩═╩═╩═╩═╩═╩═╩─┴─┘

		4. beginning (3 bytes) and end of ROM (2 bytes) left unused, rest
		(5 bytes) used by application - begin == 3, end == 8

		      begin      end
		        |         |
		        v         v
		 ┌─┬─┬─╦═╦═╦═╦═╦═╦─┬─┐
		 │0│1│2║3║4║5║6║7║8│9│
		 └─┴─┴─╩═╩═╩═╩═╩═╩─┴─┘

config LDSCRIPT_ROM_BEGIN
	int "Beginning of ROM" if LDSCRIPT_ROM_SIZE_MANUAL_CONFIGURATION
	range 0 CHIP_ROM_SIZE
	default 0
	help
		Offset of beginning of ROM (counting from ROM's physical address),
		bytes. Setting any value greater than zero will leave given amount of
		ROM unused by the application. See help for "Configure ROM's
		address & size in linker script" option for examples.

config LDSCRIPT_ROM_END
	int "End of ROM" if LDSCRIPT_ROM_SIZE_MANUAL_CONFIGURATION
	range LDSCRIPT_ROM_BEGIN CHIP_ROM_SIZE
	default CHIP_ROM_SIZE
	help
		Offset of end of ROM (counting from ROM's physical address), bytes.
		Setting any value lower than ROM size (CHIP_ROM_SIZE) will leave the
		last part of ROM unused by the application. See help for "Configure
		ROM's address & size in linker script" option for examples.

config BUILD_OPTIMIZATION
	string
	default "-O0" if BUILD_OPTIMIZATION_O0
	default "-O1" if BUILD_OPTIMIZATION_O1
	default "-O2" if BUILD_OPTIMIZATION_O2
	default "-O3" if BUILD_OPTIMIZATION_O3
	default "-Os" if BUILD_OPTIMIZATION_OS
	default "-Og" if BUILD_OPTIMIZATION_OG

config LINK_TIME_OPTIMIZATION_COMPILATION
	string
	default "-flto -ffat-lto-objects" if LINK_TIME_OPTIMIZATION_ENABLE
	default ""

config LINK_TIME_OPTIMIZATION_LINKING
	string
	default "-flto -fuse-linker-plugin" if LINK_TIME_OPTIMIZATION_ENABLE
	default ""

config STATIC_DESTRUCTORS_RUN_TIME_REGISTRATION
	string
	default "-fno-use-cxa-atexit" if !STATIC_DESTRUCTORS_RUN_TIME_REGISTRATION_ENABLE
	default ""

config DEBUGGING_INFORMATION_COMPILATION
	string
	default "-g -ggdb3" if DEBUGGING_INFORMATION_ENABLE
	default ""

config DEBUGGING_INFORMATION_LINKING
	string
	default "-g" if DEBUGGING_INFORMATION_ENABLE
	default ""

config ASSERT
	string
	default "-DNDEBUG" if !ASSERT_ENABLE
	default ""

endmenu
```

## source/architecture/ARM/ARMv7-M/Kconfig
```kconfig
#
# file: Kconfig
#
# author: Copyright (C) 2015 Kamil Szczygiel http://www.distortec.com http://www.freddiechopin.info
#
# This Source Code Form is subject to the terms of the Mozilla Public License, v. 2.0. If a copy of the MPL was not
# distributed with this file, You can obtain one at http://mozilla.org/MPL/2.0/.
#
# date: 2015-09-10
#

comment "ARMv7-M architecture options"

config ARCHITECTURE_ARMV7_M_MAIN_STACK_SIZE
	int "Interrupt stack size, bytes"
	range 8 4294967295
	default 2048
	help
		Size (in bytes) of "main" stack used by core exceptions and interrupts
		in Handler mode.

config ARCHITECTURE_ARMV7_M_KERNEL_BASEPRI
	int "BASEPRI value used in critical sections"
	range 1 15
	default 8
	help
		Minimal numerical priority (inclusive) of interrupt handlers that can
		use system's functions.

		During critical sections all interrupts with numeric priority above or
		equal to this value will be disabled. Interrupts with numeric priority
		below this value are never disabled, but they may not use any system's
		functions.

		Note - "lower" logical priority has "higher" numeric value!

config ARCHITECTURE_ARM_CORTEX_M3
	bool
	default n

config ARCHITECTURE_ARM_CORTEX_M4
	bool
	default n

config ARCHITECTURE_ARM_CORTEX_M7
	bool
	default n
```

## source/architecture/Kconfig
```kconfig
#
# file: Kconfig
#
# author: Copyright (C) 2015-2016 Kamil Szczygiel http://www.distortec.com http://www.freddiechopin.info
#
# This Source Code Form is subject to the terms of the Mozilla Public License, v. 2.0. If a copy of the MPL was not
# distributed with this file, You can obtain one at http://mozilla.org/MPL/2.0/.
#

if ARCHITECTURE_ARM
source source/architecture/ARM/Kconfig
endif

comment "Generic architecture options"

config ARCHITECTURE_FPU
	bool "Enable FPU"
	default y
	depends on ARCHITECTURE_HAS_FPU
	help
		Enables FPU.

config ARCHITECTURE_HAS_FPU
	bool
	default n

config ARCHITECTURE_ARM
	bool
	default n
```

## source/board/Kconfig
```kconfig
#
# file: Kconfig
#
# author: Copyright (C) 2016 Kamil Szczygiel http://www.distortec.com http://www.freddiechopin.info
#
# This Source Code Form is subject to the terms of the Mozilla Public License, v. 2.0. If a copy of the MPL was not
# distributed with this file, You can obtain one at http://mozilla.org/MPL/2.0/.
#

source "$DISTORTOS_PATH/source/board/STM32/STM32F1/NUCLEO-F103RB/Kconfig"
source "$DISTORTOS_PATH/source/board/STM32/STM32F4/32F429IDISCOVERY/Kconfig"
source "$DISTORTOS_PATH/source/board/STM32/STM32F4/NUCLEO-F401RE/Kconfig"
source "$DISTORTOS_PATH/source/board/STM32/STM32F4/STM32F4DISCOVERY/Kconfig"

comment "Generic board options"

config BOARD_LEDS_ENABLE
	bool "Enable LEDs"
	depends on BOARD_TOTAL_LEDS != 0
	default y
	help
		Enables board LEDs.

config BOARD_TOTAL_LEDS
	int
	default 0

config BOARD
	string
	default "Custom" if BOARD_CUSTOM
```

## source/board/STM32/Kconfig
```kconfig
#
# file: Kconfig
#
# author: Copyright (C) 2016 Kamil Szczygiel http://www.distortec.com http://www.freddiechopin.info
#
# This Source Code Form is subject to the terms of the Mozilla Public License, v. 2.0. If a copy of the MPL was not
# distributed with this file, You can obtain one at http://mozilla.org/MPL/2.0/.
#

if CHIP_STM32F4
source "$DISTORTOS_PATH/source/board/STM32/STM32F4/Kconfig"
endif
```

## source/board/STM32/STM32F1/NUCLEO-F103RB/Kconfig
```kconfig
#
# file: Kconfig
#
# author: Copyright (C) 2016 Kamil Szczygiel http://www.distortec.com http://www.freddiechopin.info
#
# This Source Code Form is subject to the terms of the Mozilla Public License, v. 2.0. If a copy of the MPL was not
# distributed with this file, You can obtain one at http://mozilla.org/MPL/2.0/.
#

if BOARD_NUCLEO_F103RB

config BOARD_TOTAL_LEDS
	int
	default 1

config BOARD_INCLUDES
	string
	default "source/board/STM32/STM32F1/NUCLEO-F103RB/include"

config BOARD
	string
	default "NUCLEO-F103RB"

endif	# BOARD_NUCLEO_F103RB
```

## source/board/STM32/STM32F4/32F429IDISCOVERY/Kconfig
```kconfig
#
# file: Kconfig
#
# author: Copyright (C) 2016 Kamil Szczygiel http://www.distortec.com http://www.freddiechopin.info
#
# This Source Code Form is subject to the terms of the Mozilla Public License, v. 2.0. If a copy of the MPL was not
# distributed with this file, You can obtain one at http://mozilla.org/MPL/2.0/.
#

config CHIP_STM32F4_VDD_MV_CONFIGURABLE
	bool
	default n

config CHIP_STM32F4_VDD_MV_DEFAULT
	int
	default 3000

config CHIP_STM32F4_RCC_HSE_CLOCK_BYPASS_CONFIGURABLE
	bool
	default n

config CHIP_STM32F4_RCC_HSE_CLOCK_BYPASS_DEFAULT
	bool
	default n

config CHIP_STM32F4_RCC_HSE_HZ_CONFIGURABLE
	bool
	default n

config CHIP_STM32F4_RCC_HSE_HZ_DEFAULT
	int
	default 8000000

config BOARD_INCLUDES
	string
	default "source/board/STM32/STM32F4/32F429IDISCOVERY/include"
```

## source/board/STM32/STM32F4/Kconfig
```kconfig
#
# file: Kconfig
#
# author: Copyright (C) 2016 Kamil Szczygiel http://www.distortec.com http://www.freddiechopin.info
#
# This Source Code Form is subject to the terms of the Mozilla Public License, v. 2.0. If a copy of the MPL was not
# distributed with this file, You can obtain one at http://mozilla.org/MPL/2.0/.
#

if BOARD_32F429IDISCOVERY
source "$DISTORTOS_PATH/source/board/STM32/STM32F4/32F429IDISCOVERY/Kconfig"
endif
if BOARD_NUCLEO_F401RE
source "$DISTORTOS_PATH/source/board/STM32/STM32F4/NUCLEO-F401RE/Kconfig"
endif
if BOARD_STM32F4DISCOVERY
source "$DISTORTOS_PATH/source/board/STM32/STM32F4/STM32F4DISCOVERY/Kconfig"
endif
```

## source/board/STM32/STM32F4/NUCLEO-F401RE/Kconfig
```kconfig
#
# file: Kconfig
#
# author: Copyright (C) 2016 Kamil Szczygiel http://www.distortec.com http://www.freddiechopin.info
#
# This Source Code Form is subject to the terms of the Mozilla Public License, v. 2.0. If a copy of the MPL was not
# distributed with this file, You can obtain one at http://mozilla.org/MPL/2.0/.
#

config BOARD_TOTAL_LEDS
	int
	default 1

config CHIP_STM32F4_VDD_MV_CONFIGURABLE
	bool
	default n

config CHIP_STM32F4_VDD_MV_DEFAULT
	int
	default 3300

config BOARD_INCLUDES
	string
	default "source/board/STM32/STM32F4/NUCLEO-F401RE/include"
```

## source/chip/KConfig
```kconfig
#
# file: KConfig
#
# author: Copyright (C) 2015 Kamil Szczygiel http://www.distortec.com http://www.freddiechopin.info
#
# This Source Code Form is subject to the terms of the Mozilla Public License, v. 2.0. If a copy of the MPL was not
# distributed with this file, You can obtain one at http://mozilla.org/MPL/2.0/.
#
# date: 2015-08-24
#

menu "Chip configuration"

choice
	prompt "Chip family"
	default CHIP_STM32
	help
		Select chip family

config CHIP_STM32
	bool "STMicroelectronics STM32"
	help
		STMicroelectronics STM32 chip family

endchoice

if CHIP_STM32
source source/chip/STMicroelectronics/KConfig
endif

endmenu
```

## source/chip/Kconfig
```kconfig
#
# file: Kconfig
#
# author: Copyright (C) 2015-2017 Kamil Szczygiel http://www.distortec.com http://www.freddiechopin.info
#
# This Source Code Form is subject to the terms of the Mozilla Public License, v. 2.0. If a copy of the MPL was not
# distributed with this file, You can obtain one at http://mozilla.org/MPL/2.0/.
#

menu "Board, chip & architecture configuration"

choice
	prompt "Chip family"
	help
		Select chip family

source "$OUTPUT/Kconfig-chipFamilyChoices1"

endchoice

source "$OUTPUT/Kconfig-chipFamilyChoices2"

choice
	prompt "Board"
	help
		Select board

config BOARD_CUSTOM
	bool "Custom board"
	help
		Custom board

source "$OUTPUT/Kconfig-boardChoices"

endchoice

if BOARD_CUSTOM

source "$OUTPUT/Kconfig-chipChoices"

endif	# BOARD_CUSTOM

source "$OUTPUT/Kconfig-board"

source "$OUTPUT/Kconfig-chipOptions"

menu "Peripherals configuration"

source "$OUTPUT/Kconfig-peripheralsOptions"

endmenu

comment "Generic chip options"

source "$DISTORTOS_PATH/source/architecture/Kconfig"

config CHIP_ROM_SIZE
	int
	default 0

config CHIP_ROM_ADDRESS
	hex
	default 0
	depends on CHIP_ROM_SIZE != 0

endmenu
```

## source/chip/STM32/Kconfig
```kconfig
#
# file: Kconfig
#
# author: Copyright (C) 2015-2016 Kamil Szczygiel http://www.distortec.com http://www.freddiechopin.info
#
# This Source Code Form is subject to the terms of the Mozilla Public License, v. 2.0. If a copy of the MPL was not
# distributed with this file, You can obtain one at http://mozilla.org/MPL/2.0/.
#

if CHIP_STM32F1
source "$DISTORTOS_PATH/source/chip/STM32/STM32F1/Kconfig"
endif
if CHIP_STM32F4
source "$DISTORTOS_PATH/source/chip/STM32/STM32F4/Kconfig"
endif
```
