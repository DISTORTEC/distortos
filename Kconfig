## source/scheduler/KConfig
```kconfig
#
# file: KConfig
#
# author: Copyright (C) 2015 Kamil Szczygiel http://www.distortec.com http://www.freddiechopin.info
#
# This Source Code Form is subject to the terms of the Mozilla Public License, v. 2.0. If a copy of the MPL was not
# distributed with this file, You can obtain one at http://mozilla.org/MPL/2.0/.
#
# date: 2015-08-24
#

menu "Scheduler configuration"

config TICK_CLOCK
	int "Tick clock frequency, Hz"
	range 1 4294967295
	default 16000000
	help
		Frequency of timer used for system ticks, Hz.

config TICK_RATE_HZ
	int "Tick rate, Hz"
	range 1 TICK_CLOCK
	default 1000
	help
		System's tick rate, Hz.

config ROUND_ROBIN_RATE_HZ
	int "Round-robin rate, Hz"
	range 1 TICK_RATE_HZ
	default 10
	help
		Round-robin rate, Hz.

config MAIN_THREAD_CAN_RECEIVE_SIGNALS
	bool "Enable reception of signals for main thread"
	default n
	help
		Enable reception of signals for main thread.

endmenu
```

## source/scheduler/Kconfig
```kconfig
#
# file: Kconfig
#
# author: Copyright (C) 2015-2017 Kamil Szczygiel http://www.distortec.com http://www.freddiechopin.info
#
# This Source Code Form is subject to the terms of the Mozilla Public License, v. 2.0. If a copy of the MPL was not
# distributed with this file, You can obtain one at http://mozilla.org/MPL/2.0/.
#

menu "Scheduler configuration"

config TICK_FREQUENCY
	int "Tick frequency, Hz"
	range 1 4294967295
	default 1000
	help
		System's tick frequency, Hz.

config ROUND_ROBIN_FREQUENCY
	int "Round-robin frequency, Hz"
	range 1 TICK_FREQUENCY
	default 10
	help
		Round-robin frequency, Hz.

config THREAD_DETACH_ENABLE
	bool "Enable support for thread detachment"
	default n
	help
		Enable functions that "detach" dynamic threads:
		- ThisThread::detach();
		- Thread::detach();

		When this options is not selected, these functions are not available at
		all.

		When dynamic and detached thread terminates, it will be added to the
		global list of threads pending for deferred deletion. The thread will
		actually be deleted in idle thread, but only when two mutexes are
		successfully locked:
		- mutex that protects dynamic memory allocator;
		- mutex that synchronizes access to the list of threads pending for
		deferred deletion;

comment "main() thread options"

config MAIN_THREAD_STACK_SIZE
	int "main() thread stack size, bytes"
	range 8 4294967295
	default 2048
	help
		Size (in bytes) of stack used by thread with main() function.

config MAIN_THREAD_PRIORITY
	int "Priority of main thread"
	range 1 255
	default 127
	help
		Initial priority of main thread.

config MAIN_THREAD_CAN_RECEIVE_SIGNALS
	bool "Enable reception of signals for main thread"
	default n
	help
		Enable reception of signals for main thread.

config MAIN_THREAD_QUEUED_SIGNALS
	int "Number of queued signals for main thread"
	range 0 4294967295
	default 0
	depends on MAIN_THREAD_CAN_RECEIVE_SIGNALS
	help
		Maximal number of queued signals for main thread. 0 disables queuing of
		signals for main thread.

config MAIN_THREAD_SIGNAL_ACTIONS
	int "Number of SignalAction objects for main thread"
	range 0 32
	default 0
	depends on MAIN_THREAD_CAN_RECEIVE_SIGNALS
	help
		Maximal number of different SignalAction objects for main thread. 0
		disables catching of signals for main thread.

comment "Runtime checks"

config CHECK_FUNCTION_CONTEXT_ENABLE
	bool "Check context of functions"
	default n
	help
		Some functions may only be used from thread context, as using them from
		interrupt context results in undefined behaviour. There are several
		groups of functions to which this restriction applies (some functions
		fall into several categories at once):
		1. all blocking functions, like callOnce(), FifoQueue::push(),
		Semaphore::wait(), ..., as an attempt to block current thread of
		execution (not to be confused with current thread) is not possible in
		interrupt context;
		2. all mutex functions, as the concept of ownership by a thread - core
		feature of mutex - cannot be fulfilled in interrupt context;
		3. all functions from ThisThread namespace (including
		ThisThread::Signals namespace), as in interrupt context they would
		access a random thread that happened to be executing at that particular
		moment;

		Using such functions from interrupt context is a common bug in
		applications which can be easily introduced and very hard to find, as
		the symptoms may appear only under certain circumstances.

		Selecting this option enables context checks in all functions with such
		requirements. If any of them is used from interrupt context,
		FATAL_ERROR() will be called.

config CHECK_STACK_POINTER_RANGE_CONTEXT_SWITCH_ENABLE
	bool "Check stack pointer range during context switch"
	default n
	help
		Simple range checking of preempted thread's stack pointer can be
		performed during context switches. It is relatively fast, but cannot
		detect all stack overflows. The check is done before the software stack
		frame is pushed on thread's stack, but the size of this pending stack
		frame is accounted for - the intent is to detect a stack overflow which
		is about to happen, before it can cause (further) data corrution.
		FATAL_ERROR() will be called if the stack pointer is outside valid
		range.

config CHECK_STACK_GUARD_ENABLE
	bool "Check stack guard contents during context switch"
	default n
	help
		Selecting this option extends stacks for all threads (including main()
		thread) with a "stack guard" at the overflow end. This "stack guard" -
		just as the whole stack - is filled with a sentinel value 0xed419f25
		during thread initialization. The contents of "stack guard" of
		preempted thread are checked during each context switch and if any byte
		has changed, FATAL_ERROR() will be called.

		This method is slower than simple stack pointer range checking, but is
		able to detect stack overflows much more reliably. It is still
		sufficiently fast, assuming that the size of "stack guard" is
		reasonable.

		Be advised that uninitialized variables on stack which are larger than
		size of "stack guard" can create "holes" in the stack, thus
		circumventing this detection mechanism. This especially applies to
		arrays used as buffers.

config STACK_GUARD_SIZE
	int "Stack guard size, bytes" if CHECK_STACK_GUARD_ENABLE
	range ARCHITECTURE_STACK_ALIGNMENT 4294967295 if CHECK_STACK_GUARD_ENABLE
	default 32 if CHECK_STACK_GUARD_ENABLE
	default 0
	help
		Size (in bytes) of "stack guard". Any value which is not a multiple of
		stack alignment required by architecture will be rounded up.

endmenu
```
