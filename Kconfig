## source/chip/STMicroelectronics/STM32F4/Kconfig
```kconfig
#
# file: Kconfig
#
# author: Copyright (C) 2015 Kamil Szczygiel http://www.distortec.com http://www.freddiechopin.info
#
# This Source Code Form is subject to the terms of the Mozilla Public License, v. 2.0. If a copy of the MPL was not
# distributed with this file, You can obtain one at http://mozilla.org/MPL/2.0/.
#
# date: 2015-12-13
#

#
# This file covers devices as described in following places:
# - DS9716 datasheet (STM32F401xB, STM32F401xC), Revision 5, 2015-08-06, devices listed on website at 2015-12-13;
# - DS10086 datasheet (STM32F401xD, STM32F401xE), Revision 3, 2015-01-22, devices listed on website at 2015-12-13;
# - DS8626 datasheet (STM32F405xx, STM32F407xx), Revision 6, 2015-10-19, devices listed on website at 2015-12-13;
# - DS11144 datasheet (STM32F410x8, STM32F410xB), Revision 2, 2015-12-07, devices listed on website at 2015-12-13;
# - DS10314 datasheet (STM32F411xC, STM32F411xE), Revision 4, 2015-02-04, devices listed on website at 2015-12-13;
#

choice
	prompt "STM32F4 chip"
	default CHIP_STM32F407VG
	help
		Select STM32F4 chip

config CHIP_STM32F401CB
	bool "STM32F401CB"
	select CHIP_STM32F401C
	select CHIP_HAS_UFQFPN48
	select CHIP_HAS_WLCSP49
	help
		STMicroelectronics STM32F401CB chip

config CHIP_STM32F401CC
	bool "STM32F401CC"
	select CHIP_STM32F401C
	select CHIP_HAS_UFQFPN48
	select CHIP_HAS_WLCSP49
	help
		STMicroelectronics STM32F401CC chip

config CHIP_STM32F401CD
	bool "STM32F401CD"
	select CHIP_STM32F401C
	select CHIP_HAS_UFQFPN48
	select CHIP_HAS_WLCSP49
	help
		STMicroelectronics STM32F401CD chip

config CHIP_STM32F401CE
	bool "STM32F401CE"
	select CHIP_STM32F401C
	select CHIP_HAS_UFQFPN48
	select CHIP_HAS_WLCSP49
	help
		STMicroelectronics STM32F401CE chip

config CHIP_STM32F401RB
	bool "STM32F401RB"
	select CHIP_STM32F401R
	select CHIP_HAS_LQFP64
	help
		STMicroelectronics STM32F401RB chip

config CHIP_STM32F401RC
	bool "STM32F401RC"
	select CHIP_STM32F401R
	select CHIP_HAS_LQFP64
	help
		STMicroelectronics STM32F401RC chip

config CHIP_STM32F401RD
	bool "STM32F401RD"
	select CHIP_STM32F401R
	select CHIP_HAS_LQFP64
	help
		STMicroelectronics STM32F401RD chip

config CHIP_STM32F401RE
	bool "STM32F401RE"
	select CHIP_STM32F401R
	select CHIP_HAS_LQFP64
	help
		STMicroelectronics STM32F401RE chip

config CHIP_STM32F401VB
	bool "STM32F401VB"
	select CHIP_STM32F401V
	select CHIP_HAS_LQFP100
	select CHIP_HAS_UFBGA100
	help
		STMicroelectronics STM32F401VB chip

config CHIP_STM32F401VC
	bool "STM32F401VC"
	select CHIP_STM32F401V
	select CHIP_HAS_LQFP100
	select CHIP_HAS_UFBGA100
	help
		STMicroelectronics STM32F401VC chip

config CHIP_STM32F401VD
	bool "STM32F401VD"
	select CHIP_STM32F401V
	select CHIP_HAS_LQFP100
	select CHIP_HAS_UFBGA100
	help
		STMicroelectronics STM32F401VD chip

config CHIP_STM32F401VE
	bool "STM32F401VE"
	select CHIP_STM32F401V
	select CHIP_HAS_LQFP100
	select CHIP_HAS_UFBGA100
	help
		STMicroelectronics STM32F401VE chip

config CHIP_STM32F405OE
	bool "STM32F405OE"
	select CHIP_STM32F405O
	select CHIP_HAS_WLCSP90
	help
		STMicroelectronics STM32F405OE chip

config CHIP_STM32F405OG
	bool "STM32F405OG"
	select CHIP_STM32F405O
	select CHIP_HAS_WLCSP90
	help
		STMicroelectronics STM32F405OG chip

config CHIP_STM32F405RG
	bool "STM32F405RG"
	select CHIP_STM32F405R
	select CHIP_HAS_LQFP64
	help
		STMicroelectronics STM32F405RG chip

config CHIP_STM32F405VG
	bool "STM32F405VG"
	select CHIP_STM32F405V
	select CHIP_HAS_LQFP100
	help
		STMicroelectronics STM32F405VG chip

config CHIP_STM32F405ZG
	bool "STM32F405ZG"
	select CHIP_STM32F405Z
	select CHIP_HAS_LQFP144
	help
		STMicroelectronics STM32F405ZG chip

config CHIP_STM32F407IE
	bool "STM32F407IE"
	select CHIP_STM32F407I
	select CHIP_HAS_LQFP176
	select CHIP_HAS_UFBGA176
	help
		STMicroelectronics STM32F407IE chip

config CHIP_STM32F407IG
	bool "STM32F407IG"
	select CHIP_STM32F407I
	select CHIP_HAS_LQFP176
	select CHIP_HAS_UFBGA176
	help
		STMicroelectronics STM32F407IG chip

config CHIP_STM32F407VE
	bool "STM32F407VE"
	select CHIP_STM32F407V
	select CHIP_HAS_LQFP100
	help
		STMicroelectronics STM32F407VE chip

config CHIP_STM32F407VG
	bool "STM32F407VG"
	select CHIP_STM32F407V
	select CHIP_HAS_LQFP100
	help
		STMicroelectronics STM32F407VG chip

config CHIP_STM32F407ZE
	bool "STM32F407ZE"
	select CHIP_STM32F407Z
	select CHIP_HAS_LQFP144
	help
		STMicroelectronics STM32F407ZE chip

config CHIP_STM32F407ZG
	bool "STM32F407ZG"
	select CHIP_STM32F407Z
	select CHIP_HAS_LQFP144
	help
		STMicroelectronics STM32F407ZG chip

config CHIP_STM32F410C8
	bool "STM32F410C8"
	select CHIP_STM32F410C
	select CHIP_HAS_UFQFPN48
	help
		STMicroelectronics STM32F410C8 chip

config CHIP_STM32F410CB
	bool "STM32F410CB"
	select CHIP_STM32F410C
	select CHIP_HAS_UFQFPN48
	help
		STMicroelectronics STM32F410CB chip

config CHIP_STM32F410R8
	bool "STM32F410R8"
	select CHIP_STM32F410R
	select CHIP_HAS_LQFP64
	help
		STMicroelectronics STM32F410R8 chip

config CHIP_STM32F410RB
	bool "STM32F410RB"
	select CHIP_STM32F410R
	select CHIP_HAS_LQFP64
	help
		STMicroelectronics STM32F410RB chip

config CHIP_STM32F410T8
	bool "STM32F410T8"
	select CHIP_STM32F410T
	select CHIP_HAS_WLCSP36
	help
		STMicroelectronics STM32F410T8 chip

config CHIP_STM32F410TB
	bool "STM32F410TB"
	select CHIP_STM32F410T
	select CHIP_HAS_WLCSP36
	help
		STMicroelectronics STM32F410TB chip

config CHIP_STM32F411CC
	bool "STM32F411CC"
	select CHIP_STM32F411C
	select CHIP_HAS_UFQFPN48
	select CHIP_HAS_WLCSP49
	help
		STMicroelectronics STM32F411CC chip

config CHIP_STM32F411CE
	bool "STM32F411CE"
	select CHIP_STM32F411C
	select CHIP_HAS_UFQFPN48
	select CHIP_HAS_WLCSP49
	help
		STMicroelectronics STM32F411CE chip

config CHIP_STM32F411RC
	bool "STM32F411RC"
	select CHIP_STM32F411R
	select CHIP_HAS_LQFP64
	help
		STMicroelectronics STM32F411RC chip

config CHIP_STM32F411RE
	bool "STM32F411RE"
	select CHIP_STM32F411R
	select CHIP_HAS_LQFP64
	help
		STMicroelectronics STM32F411RE chip

config CHIP_STM32F411VC
	bool "STM32F411VC"
	select CHIP_STM32F411V
	select CHIP_HAS_LQFP100
	help
		STMicroelectronics STM32F411VC chip

config CHIP_STM32F411VE
	bool "STM32F411VE"
	select CHIP_STM32F411V
	select CHIP_HAS_LQFP100
	select CHIP_HAS_UFBGA100
	help
		STMicroelectronics STM32F411VE chip

endchoice

comment "STM32F4 chip options"

config CHIP_STM32F4_VDD_MV
	int "Vdd supply voltage, mV"
	range 1800 3600
	default 3300
	help
		Vdd supply voltage of the chip, mV.

config CHIP_STM32F4_FLASH_PREFETCH_ENABLE
	bool "Enable flash prefetch"
	default y
	help
		Enable flash prefetch option in FLASH->ACR register. Early revisions of
		older STM32F4 devices don't support this feature. Enabling this feature
		may also increase noise of ADC. Check device errata sheet of selected
		chip to see whether it is affected by any of these issues.

		Flash prefetch must not be enabled when supply voltage is below 2.1V.

menu "PWR configuration"

config CHIP_STM32F4_PWR_STANDARD_CONFIGURATION_ENABLE
	bool "Enable standard configuration of PWR module"
	default y
	help
		Enable standard configuration of PWR module.

if CHIP_STM32F4_PWR_STANDARD_CONFIGURATION_ENABLE

config CHIP_STM32F4_PWR_VOLTAGE_SCALE_MODE
	int "Voltage scale mode"
	default 2 if CHIP_STM32F401
	default 1
	range 2 3 if CHIP_STM32F401
	range 1 2 if CHIP_STM32F405 || CHIP_STM32F407 || CHIP_STM32F415 || CHIP_STM32F417
	range 1 3
	help
		Select voltage scale mode.

config CHIP_STM32F4_PWR_OVER_DRIVE_ENABLE
	bool "Enable over-drive mode"
	default n
	depends on CHIP_STM32F4_PWR_VOLTAGE_SCALE_MODE = 1 && (CHIP_STM32F42 || CHIP_STM32F43 || CHIP_STM32F446 || \
		CHIP_STM32F469 || CHIP_STM32F479)
	help
		Enable over-drive mode.

		Note - over-drive mode requires voltage scale 1 mode and supply voltage
		above 2.1V.

endif	# CHIP_STM32F4_PWR_STANDARD_CONFIGURATION_ENABLE

endmenu

menu "RCC configuration"

config CHIP_STM32F4_RCC_STANDARD_CLOCK_CONFIGURATION_ENABLE
	bool "Enable standard configuration of RCC clocks"
	default y
	help
		Enable standard configuration of RCC clocks.

if CHIP_STM32F4_RCC_STANDARD_CLOCK_CONFIGURATION_ENABLE

config CHIP_STM32F4_RCC_HSE_ENABLE
	bool "Enable HSE"
	default n
	help
		Enable HSE (crystal/ceramic resonator or external user clock).

if CHIP_STM32F4_RCC_HSE_ENABLE

config CHIP_STM32F4_RCC_HSE_CLOCK_BYPASS
	bool "HSE Clock Bypass"
	default n
	help
		Selects whether HSE generator is bypassed. If enabled, external user
		clock connected to OSC_IN must be used. Crystal or ceramic resonator
		connected to OSC_IN and OSC_OUT must be used otherwise.

config CHIP_STM32F4_RCC_HSE_HZ
	int "Frequency of HSE clock, Hz"
	range 1000000 50000000 if CHIP_STM32F4_RCC_HSE_CLOCK_BYPASS
	range 4000000 26000000
	default 8000000
	help
		Frequency of HSE clock, Hz. This can be:
		- "HSE Clock Bypass" disabled - crystal/ceramic resonator connected to
		OSC_IN and OSC_OUT [4MHz; 26MHz];
		- "HSE Clock Bypass" enabled - external user clock connected to OSC_IN
		[1MHz; 50MHz];

endif	# CHIP_STM32F4_RCC_HSE_ENABLE

config CHIP_STM32F4_RCC_PLL_ENABLE
	bool "Enable PLL"
	default y
	help
		Enable PLL.

if CHIP_STM32F4_RCC_PLL_ENABLE

choice
	prompt "Clock source of main and audio PLLs"
	default CHIP_STM32F4_RCC_PLLSRC_HSI
	help
		Select clock source of main and audio PLLs.

config CHIP_STM32F4_RCC_PLLSRC_HSI
	bool "HSI"
	help
		Select HSI as clock source of main and audio PLLs.

config CHIP_STM32F4_RCC_PLLSRC_HSE
	bool "HSE"
	depends on CHIP_STM32F4_RCC_HSE_ENABLE
	help
		Select HSE as clock source of main and audio PLLs.

endchoice

config CHIP_STM32F4_RCC_PLLM
	int "PLLM value"
	range 2 63
	default 8 if CHIP_STM32F4_RCC_PLLSRC_HSE
	default 16
	help
		PLLM value for main PLL and audio PLLI2S. It is used to divide PLL
		input clock (PLLin) before it is fed to VCO. VCO input frequency
		(VCOin) must be in the range [1MHz; 2MHz], 2MHz is recommended to limit
		PLL jitter.

		VCOin = PLLin / PLLM

config CHIP_STM32F4_RCC_PLLN
	int "PLLN value"
	range 192 432 if CHIP_STM32F401 || CHIP_STM32F446
	range 50 432
	default 336
	help
		PLLN value for main PLL. It is used to multiply VCO input frequency
		(VCOin). Resulting VCO output frequency (VCOout) must be in the range:
		- [192MHz; 432MHz] for STM32F401 chips,
		- [100MHz; 432MHz] for other chips.

		VCOout = VCOin * PLLN = PLLin / PLLM * PLLN

choice
	prompt "PLLP value"
	default CHIP_STM32F4_RCC_PLLP_DIV4 if CHIP_STM32F401 || CHIP_STM32F410 || CHIP_STM32F411
	default CHIP_STM32F4_RCC_PLLP_DIV2
	help
		PLLP value for main PLL. It is used to divide VCO output frequency
		(VCOout). PLL output frequency (PLLout) must not exceed:
		* for STM32F401 chips:
		  - 84MHz in voltage scale 2 mode,
		  - 60MHz in voltage scale 3 mode,
		* for STM32F405, STM32F407, STM32F415 and STM32F417 chips:
		  - 168MHz in voltage scale 1 mode,
		  - 144MHz in voltage scale 2 mode,
		* for STM32F410 and STM32F411 chips:
		  - 100MHz in voltage scale 1 mode,
		  - 84MHz in voltage scale 2 mode,
		  - 64MHz in voltage scale 3 mode,
		* for other chips:
		  - 180MHz in voltage scale 1 mode with over-drive mode,
		  - 168MHz in voltage scale 1 mode,
		  - 144MHz in voltage scale 2 mode,
		  - 120MHz in voltage scale 3 mode.

		PLLout = VCOout / PLLP = PLLin / PLLM * PLLN / PLLP

config CHIP_STM32F4_RCC_PLLP_DIV2
	bool "2"
	help
		PLLP == 2

config CHIP_STM32F4_RCC_PLLP_DIV4
	bool "4"
	help
		PLLP == 4

config CHIP_STM32F4_RCC_PLLP_DIV6
	bool "6"
	help
		PLLP == 6

config CHIP_STM32F4_RCC_PLLP_DIV8
	bool "8"
	help
		PLLP == 8

endchoice

config CHIP_STM32F4_RCC_PLLQ
	int "PLLQ value"
	range 2 15
	default 7
	help
		PLLQ value for main PLL. It is used to divide VCO output frequency
		(VCOout) to produce clock for USB OTG FS, SDIO and RNG (PLLQout). USB
		OTG FS requires a 48MHz clock for correct operation, while SDIO and RNG
		need a frequency lower than or equal to 48MHz to work correctly.

		PLLQout = VCOout / PLLQ = PLLin / PLLM * PLLN / PLLQ

config CHIP_STM32F4_RCC_PLLR
	int "PLLR value"
	range 2 7
	default 7
	depends on CHIP_STM32F446 || CHIP_STM32F469 || CHIP_STM32F479
	help
		PLLR value for main PLL. It is used to divide VCO output frequency
		(VCOout) to produce clock for peripherals like DSI, SAI or SPDIF
		(PLLRout). This clock can also be used as source of system clock.

		PLLRout = VCOout / PLLR = PLLin / PLLM * PLLN / PLLR

endif	# CHIP_STM32F4_RCC_PLL_ENABLE

choice
	prompt "System clock source"
	default CHIP_STM32F4_RCC_SYSCLK_PLL
	help
		Select system clock source.

config CHIP_STM32F4_RCC_SYSCLK_HSI
	bool "HSI"
	help
		HSI oscillator selected as system clock.

config CHIP_STM32F4_RCC_SYSCLK_HSE
	bool "HSE"
	depends on CHIP_STM32F4_RCC_HSE_ENABLE
	help
		HSE oscillator selected as system clock.

config CHIP_STM32F4_RCC_SYSCLK_PLL
	bool "PLL"
	depends on CHIP_STM32F4_RCC_PLL_ENABLE
	help
		Main PLL selected as system clock.

config CHIP_STM32F4_RCC_SYSCLK_PLLR
	bool "Main PLL's \"/R\" output"
	depends on CHIP_STM32F446 || CHIP_STM32F469 || CHIP_STM32F479
	help
		Main PLL's "/R" output selected as system clock.

endchoice

choice
	prompt "AHB divider"
	default CHIP_STM32F4_RCC_AHB_DIV1
	help
		AHB clock division factor

		AHBclk = SYSclk / AHBdivider

config CHIP_STM32F4_RCC_AHB_DIV1
	bool "1"
	help
		System clock not divided

config CHIP_STM32F4_RCC_AHB_DIV2
	bool "2"
	help
		System clock divided by 2

config CHIP_STM32F4_RCC_AHB_DIV4
	bool "4"
	help
		System clock divided by 4

config CHIP_STM32F4_RCC_AHB_DIV8
	bool "8"
	help
		System clock divided by 8

config CHIP_STM32F4_RCC_AHB_DIV16
	bool "16"
	help
		System clock divided by 16

config CHIP_STM32F4_RCC_AHB_DIV64
	bool "64"
	help
		System clock divided by 64

config CHIP_STM32F4_RCC_AHB_DIV128
	bool "128"
	help
		System clock divided by 128

config CHIP_STM32F4_RCC_AHB_DIV256
	bool "256"
	help
		System clock divided by 256

config CHIP_STM32F4_RCC_AHB_DIV512
	bool "512"
	help
		System clock divided by 512

endchoice

choice
	prompt "APB1 (low speed) divider"
	default CHIP_STM32F4_RCC_APB1_DIV2 if CHIP_STM32F401 || CHIP_STM32F410 || CHIP_STM32F411
	default CHIP_STM32F4_RCC_APB1_DIV4
	help
		APB1 (low speed) clock division factor. APB1 clock must not exceed:
		- 42MHz for STM32F401, STM32F405, STM32F407, STM32F415 and STM32F417
		chips,
		- 50MHz for STM32F410 and STM32F411 chips,
		- 45MHz for other chips.

		APB1clk = AHBclk / APB1divider

config CHIP_STM32F4_RCC_APB1_DIV1
	bool "1"
	help
		AHB clock not divided

config CHIP_STM32F4_RCC_APB1_DIV2
	bool "2"
	help
		AHB clock divided by 2

config CHIP_STM32F4_RCC_APB1_DIV4
	bool "4"
	help
		AHB clock divided by 4

config CHIP_STM32F4_RCC_APB1_DIV8
	bool "8"
	help
		AHB clock divided by 8

config CHIP_STM32F4_RCC_APB1_DIV16
	bool "16"
	help
		AHB clock divided by 16

endchoice

choice
	prompt "APB2 (high speed) divider"
	default CHIP_STM32F4_RCC_APB2_DIV1 if CHIP_STM32F401 || CHIP_STM32F410 || CHIP_STM32F411
	default CHIP_STM32F4_RCC_APB2_DIV2
	help
		APB2 (high speed) clock division factor. APB2 clock must not exceed:
		- 84MHz for STM32F401, STM32F405, STM32F407, STM32F415 and STM32F417
		chips,
		- 100MHz for STM32F410 and STM32F411 chips,
		- 90MHz for other chips.

		APB2clk = AHBclk / APB2divider

config CHIP_STM32F4_RCC_APB2_DIV1
	bool "1"
	help
		AHB clock not divided

config CHIP_STM32F4_RCC_APB2_DIV2
	bool "2"
	help
		AHB clock divided by 2

config CHIP_STM32F4_RCC_APB2_DIV4
	bool "4"
	help
		AHB clock divided by 4

config CHIP_STM32F4_RCC_APB2_DIV8
	bool "8"
	help
		AHB clock divided by 8

config CHIP_STM32F4_RCC_APB2_DIV16
	bool "16"
	help
		AHB clock divided by 16

endchoice

endif	# CHIP_STM32F4_RCC_STANDARD_CLOCK_CONFIGURATION_ENABLE

if !CHIP_STM32F4_RCC_STANDARD_CLOCK_CONFIGURATION_ENABLE

config CHIP_STM32F4_RCC_AHB_HZ
	int "Frequency of AHB clock, Hz"
	range 1 84000000 if CHIP_STM32F401
	range 1 168000000 if CHIP_STM32F405 || CHIP_STM32F407 || CHIP_STM32F415 || CHIP_STM32F417
	range 1 100000000 if CHIP_STM32F410 || CHIP_STM32F411
	range 1 180000000
	default 16000000
	help
		Frequency of AHB clock, Hz. RCC must be configured by user to achieve
		that frequency.

endif	# !CHIP_STM32F4_RCC_STANDARD_CLOCK_CONFIGURATION_ENABLE

endmenu

config CHIP_STM32F40
	bool
	default n

config CHIP_STM32F401
	bool
	default n
	select CHIP_STM32F40

config CHIP_STM32F401C
	bool
	default n
	select CHIP_STM32F401

config CHIP_STM32F401R
	bool
	default n
	select CHIP_STM32F401

config CHIP_STM32F401V
	bool
	default n
	select CHIP_STM32F401

config CHIP_STM32F405
	bool
	default n
	select CHIP_STM32F40

config CHIP_STM32F405O
	bool
	default n
	select CHIP_STM32F405

config CHIP_STM32F405R
	bool
	default n
	select CHIP_STM32F405

config CHIP_STM32F405V
	bool
	default n
	select CHIP_STM32F405

config CHIP_STM32F405Z
	bool
	default n
	select CHIP_STM32F405

config CHIP_STM32F407
	bool
	default n
	select CHIP_STM32F40

config CHIP_STM32F407I
	bool
	default n
	select CHIP_STM32F407

config CHIP_STM32F407V
	bool
	default n
	select CHIP_STM32F407

config CHIP_STM32F407Z
	bool
	default n
	select CHIP_STM32F407

config CHIP_STM32F41
	bool
	default n

config CHIP_STM32F410
	bool
	default n
	select CHIP_STM32F41

config CHIP_STM32F410C
	bool
	default n
	select CHIP_STM32F410

config CHIP_STM32F410R
	bool
	default n
	select CHIP_STM32F410

config CHIP_STM32F410T
	bool
	default n
	select CHIP_STM32F410

config CHIP_STM32F411
	bool
	default n
	select CHIP_STM32F41

config CHIP_STM32F411C
	bool
	default n
	select CHIP_STM32F411

config CHIP_STM32F411R
	bool
	default n
	select CHIP_STM32F411

config CHIP_STM32F411V
	bool
	default n
	select CHIP_STM32F411

config CHIP_STM32F4_BKPSRAM_SIZE
	int
	default 4096 if CHIP_STM32F405 || CHIP_STM32F407
	default 0

config CHIP_STM32F4_BKPSRAM_ADDRESS
	hex
	default 0x40024000
	depends on CHIP_STM32F4_BKPSRAM_SIZE != 0

config CHIP_STM32F4_CCM_SIZE
	int
	default 65536 if CHIP_STM32F405 || CHIP_STM32F407
	default 0

config CHIP_STM32F4_CCM_ADDRESS
	hex
	default 0x10000000
	depends on CHIP_STM32F4_CCM_SIZE != 0

config CHIP_STM32F4_FLASH_SIZE
	int
	default 65536 if CHIP_STM32F410C8 || CHIP_STM32F410R8 || CHIP_STM32F410T8
	default 131072 if CHIP_STM32F401CB || CHIP_STM32F401RB || CHIP_STM32F401VB || CHIP_STM32F410CB || \
		CHIP_STM32F410RB || CHIP_STM32F410TB
	default 262144 if CHIP_STM32F401CC || CHIP_STM32F401RC || CHIP_STM32F401VC || CHIP_STM32F411CC || \
		CHIP_STM32F411RC || CHIP_STM32F411VC
	default 393216 if CHIP_STM32F401CD || CHIP_STM32F401RD || CHIP_STM32F401VD
	default 524288 if CHIP_STM32F401CE || CHIP_STM32F401RE || CHIP_STM32F401VE || CHIP_STM32F405OE || \
		CHIP_STM32F407IE || CHIP_STM32F407VE || CHIP_STM32F407ZE || CHIP_STM32F411CE || CHIP_STM32F411RE || \
		CHIP_STM32F411VE
	default 1048576 if CHIP_STM32F405OG || CHIP_STM32F405RG || CHIP_STM32F405VG || CHIP_STM32F405ZG || \
		CHIP_STM32F407IG || CHIP_STM32F407VG || CHIP_STM32F407ZG
	default 0

config CHIP_STM32F4_FLASH_ADDRESS
	hex
	default 0x08000000
	depends on CHIP_STM32F4_FLASH_SIZE != 0

config CHIP_STM32F4_SRAM1_SIZE
	int
	default 32768 if CHIP_STM32F410
	default 65536 if CHIP_STM32F401CB || CHIP_STM32F401CC || CHIP_STM32F401RB || CHIP_STM32F401RC || \
		CHIP_STM32F401VB || CHIP_STM32F401VC
	default 98304 if CHIP_STM32F401CD || CHIP_STM32F401CE || CHIP_STM32F401RD || CHIP_STM32F401RE || \
		CHIP_STM32F401VD || CHIP_STM32F401VE
	default 114688 if CHIP_STM32F405 || CHIP_STM32F407
	default 131072 if CHIP_STM32F411
	default 0

config CHIP_STM32F4_SRAM1_ADDRESS
	hex
	default 0x20000000
	depends on CHIP_STM32F4_SRAM1_SIZE != 0

config CHIP_STM32F4_SRAM2_SIZE
	int
	default 16384 if CHIP_STM32F405 || CHIP_STM32F407
	default 0

config CHIP_STM32F4_SRAM2_ADDRESS
	hex
	default 0x2001C000
	depends on CHIP_STM32F4_SRAM2_SIZE != 0

config CHIP_STM32F4_SRAM3_SIZE
	int
	default 0

config CHIP_STM32F4_SRAM3_ADDRESS
	hex
	default 0x20020000
	depends on CHIP_STM32F4_SRAM3_SIZE != 0

config CHIP
	string
	default "STM32F401CB" if CHIP_STM32F401CB
	default "STM32F401CC" if CHIP_STM32F401CC
	default "STM32F401CD" if CHIP_STM32F401CD
	default "STM32F401CE" if CHIP_STM32F401CE
	default "STM32F401RB" if CHIP_STM32F401RB
	default "STM32F401RC" if CHIP_STM32F401RC
	default "STM32F401RD" if CHIP_STM32F401RD
	default "STM32F401RE" if CHIP_STM32F401RE
	default "STM32F401VB" if CHIP_STM32F401VB
	default "STM32F401VC" if CHIP_STM32F401VC
	default "STM32F401VD" if CHIP_STM32F401VD
	default "STM32F401VE" if CHIP_STM32F401VE
	default "STM32F405OE" if CHIP_STM32F405OE
	default "STM32F405OG" if CHIP_STM32F405OG
	default "STM32F405RG" if CHIP_STM32F405RG
	default "STM32F405VG" if CHIP_STM32F405VG
	default "STM32F405ZG" if CHIP_STM32F405ZG
	default "STM32F407IE" if CHIP_STM32F407IE
	default "STM32F407IE" if CHIP_STM32F407IE
	default "STM32F407IG" if CHIP_STM32F407IG
	default "STM32F407IG" if CHIP_STM32F407IG
	default "STM32F407VE" if CHIP_STM32F407VE
	default "STM32F407VG" if CHIP_STM32F407VG
	default "STM32F407ZE" if CHIP_STM32F407ZE
	default "STM32F407ZG" if CHIP_STM32F407ZG
	default "STM32F410C8" if CHIP_STM32F410C8
	default "STM32F410CB" if CHIP_STM32F410CB
	default "STM32F410R8" if CHIP_STM32F410R8
	default "STM32F410RB" if CHIP_STM32F410RB
	default "STM32F410T8" if CHIP_STM32F410T8
	default "STM32F410TB" if CHIP_STM32F410TB
	default "STM32F411CC" if CHIP_STM32F411CC
	default "STM32F411CE" if CHIP_STM32F411CE
	default "STM32F411RC" if CHIP_STM32F411RC
	default "STM32F411RE" if CHIP_STM32F411RE
	default "STM32F411VC" if CHIP_STM32F411VC
	default "STM32F411VE" if CHIP_STM32F411VE

config CHIP_INCLUDES
	string
	default "source/chip/STMicroelectronics/STM32F4/include external/CMSIS-STM32F4 external/CMSIS"
```
